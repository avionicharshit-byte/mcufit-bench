// Times TFLite Micro inference on any Arduino-supported board, one JSON record
// per model. Same measurement as main/main.cc and mcufit_bench_nano, but the
// board identity is detected at compile time instead of hard-coded.
//
// Do not open this directly. Run scripts/prepare_arduino.py first, which copies
// the model arrays in and writes model_list.h.

// model_list.h also pulls in the TFLM library, because which one a board needs
// differs and arduino-cli only finds a library it can see named in a plain
// include. Selecting it with __has_include does not work: nothing is on the
// include path yet at the point the scanner runs, so every branch is false.
#include "model_list.h"

#include "tensorflow/lite/micro/micro_interpreter.h"
#include "tensorflow/lite/micro/micro_log.h"
#include "tensorflow/lite/micro/micro_mutable_op_resolver.h"
#include "tensorflow/lite/micro/micro_profiler_interface.h"
#include "tensorflow/lite/schema/schema_generated.h"

#include "model_data.h"

// ---------------------------------------------------------------------------
// Board identity, from the core's own predefined macros.
//
// If your board lands on "unknown", add it here and send the patch. Guessing a
// chip name is worse than reporting that we do not know it, because the number
// ends up in a database that other people trust.
// ---------------------------------------------------------------------------

#if defined(CONFIG_IDF_TARGET_ESP32S3)
#define MCUFIT_CHIP "ESP32-S3"
#elif defined(CONFIG_IDF_TARGET_ESP32S2)
#define MCUFIT_CHIP "ESP32-S2"
#elif defined(CONFIG_IDF_TARGET_ESP32C3)
#define MCUFIT_CHIP "ESP32-C3"
#elif defined(CONFIG_IDF_TARGET_ESP32C6)
#define MCUFIT_CHIP "ESP32-C6"
#elif defined(CONFIG_IDF_TARGET_ESP32P4)
#define MCUFIT_CHIP "ESP32-P4"
#elif defined(ARDUINO_ARCH_ESP32)
#define MCUFIT_CHIP "ESP32"
#elif defined(ARDUINO_ARCH_ESP8266)
#define MCUFIT_CHIP "ESP8266"
#elif defined(PICO_RP2350) || defined(ARDUINO_ARCH_RP2350)
#define MCUFIT_CHIP "RP2350"
#elif defined(ARDUINO_ARCH_RP2040)
#define MCUFIT_CHIP "RP2040"
#elif defined(ARDUINO_ARDUINO_NANO33BLE) || defined(ARDUINO_NANO33BLE)
#define MCUFIT_CHIP "nRF52840"
#elif defined(ARDUINO_TEENSY41) || defined(ARDUINO_TEENSY40) || defined(__IMXRT1062__)
#define MCUFIT_CHIP "i.MX RT1062"
#elif defined(NRF52840_XXAA)
#define MCUFIT_CHIP "nRF52840"
#elif defined(NRF52833_XXAA)
#define MCUFIT_CHIP "nRF52833"
#elif defined(NRF52832_XXAA) || defined(NRF52_SERIES)
#define MCUFIT_CHIP "nRF52832"
#elif defined(STM32H7xx)
#define MCUFIT_CHIP "STM32H7"
#elif defined(STM32F7xx)
#define MCUFIT_CHIP "STM32F7"
#elif defined(STM32F4xx)
#define MCUFIT_CHIP "STM32F4"
#elif defined(STM32F1xx)
#define MCUFIT_CHIP "STM32F1"
#elif defined(__SAMD51__)
#define MCUFIT_CHIP "SAMD51"
#elif defined(ARDUINO_ARCH_SAMD)
#define MCUFIT_CHIP "SAMD21"
#elif defined(ARDUINO_ARCH_RENESAS)
#define MCUFIT_CHIP "RA4M1"
#elif defined(AM_PART_APOLLO3)
#define MCUFIT_CHIP "Apollo3"
#elif defined(ARDUINO_ARCH_AVR)
#define MCUFIT_CHIP "AVR"
#else
#define MCUFIT_CHIP "unknown"
#endif

// Which maths kernels TFLM actually ends up calling. This is a compile-time
// guess from the target's features, not something the runtime reports, so it
// travels with a flag saying so. esp-nn is built into the ESP32 TFLM ports;
// CMSIS-NN's optimised paths need the Armv7E-M DSP extension.
#if defined(ARDUINO_ARCH_ESP32)
#define MCUFIT_KERNELS "esp-nn"
#elif defined(__ARM_FEATURE_DSP)
#define MCUFIT_KERNELS "cmsis-nn"
#elif defined(__arm__)
#define MCUFIT_KERNELS "reference-c-no-dsp"
#else
#define MCUFIT_KERNELS "reference-c"
#endif

// Arena is a static array, so it is sized at compile time. 100 KB suits the
// four bundled models on a 256 KB board. Lower it with -DMCUFIT_ARENA_KB=NN if
// the sketch will not fit; arena size does not affect the timing, only whether
// the model can be allocated at all.
#ifndef MCUFIT_ARENA_KB
#define MCUFIT_ARENA_KB 100
#endif

namespace {

constexpr size_t kArenaBytes = MCUFIT_ARENA_KB * 1024;
constexpr int kWarmupRuns = 3;
constexpr int kTimedRuns = 30;
constexpr int kProfileRuns = 5;

alignas(16) uint8_t g_arena[kArenaBytes];

struct Model {
  const char* name;
  const unsigned char* data;
  unsigned int len;
  const char* sha256;
};

// Generated by scripts/prepare_arduino.py from the models you asked for.
const Model kModels[] = MCUFIT_MODEL_LIST;

uint32_t cpuMhz() {
#if defined(ARDUINO_ARCH_ESP32)
  return getCpuFrequencyMhz();  // Reports the real clock, which F_CPU does not.
#elif defined(F_CPU)
  return F_CPU / 1000000UL;
#else
  return 0;  // Reported as 0 so nobody mistakes a guess for a measurement.
#endif
}

// TFLM wraps each operator's invoke in a ScopedMicroProfiler tagged with the
// operator name, so totalling per tag gives the cost of each layer type.
class TagProfiler : public tflite::MicroProfilerInterface {
 public:
  static constexpr int kMaxTags = 16;

  uint32_t BeginEvent(const char* tag) override {
    tag_ = tag;
    start_ = micros();
    return 0;
  }

  void EndEvent(uint32_t) override {
    const uint32_t elapsed = micros() - start_;
    for (int i = 0; i < count_; ++i) {
      if (strcmp(tags_[i], tag_) == 0) {
        total_us_[i] += elapsed;
        calls_[i] += 1;
        return;
      }
    }
    if (count_ < kMaxTags) {
      tags_[count_] = tag_;
      total_us_[count_] = elapsed;
      calls_[count_] = 1;
      ++count_;
    }
  }

  void reset() { count_ = 0; }
  int count() const { return count_; }
  const char* tag(int i) const { return tags_[i]; }
  uint64_t total_us(int i) const { return total_us_[i]; }
  int calls(int i) const { return calls_[i]; }

 private:
  const char* tag_ = nullptr;
  uint32_t start_ = 0;
  const char* tags_[kMaxTags] = {};
  uint64_t total_us_[kMaxTags] = {};
  int calls_[kMaxTags] = {};
  int count_ = 0;
};

void profileOne(const Model& m, const tflite::Model* model,
                tflite::MicroMutableOpResolver<7>& resolver);

void sortAscending(uint32_t* v, int n) {
  for (int i = 1; i < n; ++i) {
    uint32_t key = v[i];
    int j = i - 1;
    while (j >= 0 && v[j] > key) { v[j + 1] = v[j]; --j; }
    v[j + 1] = key;
  }
}

// The fields every record carries, so a target that was added later still joins
// cleanly against the existing rows.
void printIdentity() {
  Serial.print("\"target\":\""); Serial.print(MCUFIT_TARGET);
  Serial.print("\",\"chip\":\""); Serial.print(MCUFIT_CHIP);
  Serial.print("\",\"cpu_mhz\":"); Serial.print(cpuMhz());
  Serial.print(",\"kernels\":\""); Serial.print(MCUFIT_KERNELS);
  Serial.print("\",\"kernels_source\":\"compile-time-guess\"");
  Serial.print(",\"tflm_library\":\""); Serial.print(MCUFIT_TFLM_LIB);
  Serial.print("\"");
}

void runOne(const Model& m) {
  const tflite::Model* model = tflite::GetModel(m.data);
  if (model->version() != TFLITE_SCHEMA_VERSION) {
    Serial.print("SKIP schema "); Serial.println(m.name);
    return;
  }

  // Union of the operators across the bundled models.
  static tflite::MicroMutableOpResolver<7> resolver;
  static bool built = false;
  if (!built) {
    resolver.AddConv2D();
    resolver.AddDepthwiseConv2D();
    resolver.AddFullyConnected();
    resolver.AddAveragePool2D();
    resolver.AddAdd();
    resolver.AddReshape();
    resolver.AddSoftmax();
    built = true;
  }

  tflite::MicroInterpreter interpreter(model, resolver, g_arena, kArenaBytes);
  if (interpreter.AllocateTensors() != kTfLiteOk) {
    Serial.print("SKIP alloc "); Serial.print(m.name);
    Serial.print(" (arena is "); Serial.print((unsigned)kArenaBytes);
    Serial.println(" B, raise MCUFIT_ARENA_KB)");
    return;
  }

  const size_t arenaUsed = interpreter.arena_used_bytes();
  TfLiteTensor* input = interpreter.input(0);
  // Content does not change the work done, only the answer.
  memset(input->data.data, 0, input->bytes);

  for (int i = 0; i < kWarmupRuns; ++i) interpreter.Invoke();

  static uint32_t samples[kTimedRuns];
  uint64_t total = 0;
  for (int i = 0; i < kTimedRuns; ++i) {
    const uint32_t start = micros();
    const TfLiteStatus status = interpreter.Invoke();
    const uint32_t elapsed = micros() - start;
    if (status != kTfLiteOk) {
      Serial.print("SKIP invoke "); Serial.println(m.name);
      return;
    }
    samples[i] = elapsed;
    total += elapsed;
  }
  sortAscending(samples, kTimedRuns);

  Serial.print("\nMCUFIT_RESULT {\"schema\":1,\"model\":\""); Serial.print(m.name);
  Serial.print("\",\"model_sha256\":\""); Serial.print(m.sha256);
  Serial.print("\",\"model_bytes\":"); Serial.print(m.len);
  Serial.print(",");
  printIdentity();
  Serial.print(",\"opt_level\":\"arduino-default\"");
  Serial.print(",\"arena_used_bytes\":"); Serial.print((unsigned)arenaUsed);
  Serial.print(",\"runs\":"); Serial.print(kTimedRuns);
  Serial.print(",\"min_us\":"); Serial.print(samples[0]);
  Serial.print(",\"p50_us\":"); Serial.print(samples[kTimedRuns / 2]);
  Serial.print(",\"mean_us\":"); Serial.print((uint32_t)(total / kTimedRuns));
  Serial.print(",\"max_us\":"); Serial.print(samples[kTimedRuns - 1]);
  Serial.println("}");

  Serial.print(m.name); Serial.print(": median ");
  Serial.print(samples[kTimedRuns / 2] / 1000);
  Serial.print(" ms, arena "); Serial.println((unsigned)arenaUsed);

  profileOne(m, model, resolver);
}

// A second interpreter with a profiler attached, so per-layer cost is measured
// rather than inferred from whole-model totals.
void profileOne(const Model& m, const tflite::Model* model,
                tflite::MicroMutableOpResolver<7>& resolver) {
  static TagProfiler profiler;
  profiler.reset();

  tflite::MicroInterpreter interpreter(model, resolver, g_arena, kArenaBytes,
                                       nullptr, &profiler);
  if (interpreter.AllocateTensors() != kTfLiteOk) {
    Serial.print("SKIP profile "); Serial.println(m.name);
    return;
  }
  memset(interpreter.input(0)->data.data, 0, interpreter.input(0)->bytes);

  interpreter.Invoke();
  profiler.reset();

  for (int i = 0; i < kProfileRuns; ++i) interpreter.Invoke();

  if (profiler.count() == 0) {
    // TF_LITE_STRIP_ERROR_STRINGS compiles the operator tags out, so there is
    // nothing to attribute time to. Whole-model numbers above are still good.
    Serial.println("NOTE per-layer profiling unavailable on this build");
    return;
  }

  for (int i = 0; i < profiler.count(); ++i) {
    Serial.print("MCUFIT_LAYER {\"model\":\""); Serial.print(m.name);
    Serial.print("\",");
    printIdentity();
    Serial.print(",\"op\":\""); Serial.print(profiler.tag(i));
    Serial.print("\",\"calls_per_inference\":"); Serial.print(profiler.calls(i) / kProfileRuns);
    Serial.print(",\"us_per_inference\":");
    Serial.print((uint32_t)(profiler.total_us(i) / kProfileRuns));
    Serial.println("}");
  }
}

}  // namespace

void setup() {
  Serial.begin(115200);
  // Native USB: block until the host opens the port, or the run is printed to
  // nobody and lost.
  while (!Serial) {}
  delay(200);

  Serial.println();
  Serial.print("mcufit-bench portable: ");
  Serial.print(MCUFIT_CHIP);
  Serial.print(" @ "); Serial.print(cpuMhz()); Serial.print(" MHz, kernels ");
  Serial.print(MCUFIT_KERNELS);
  Serial.print(", arena "); Serial.print(MCUFIT_ARENA_KB); Serial.println(" KB");

  if (strcmp(MCUFIT_CHIP, "unknown") == 0) {
    Serial.println("WARNING chip not recognised. Fill \"chip\" in by hand before");
    Serial.println("opening a PR, and please add the macro to the sketch.");
  }
  if (cpuMhz() == 0) {
    Serial.println("WARNING clock unknown. Fill \"cpu_mhz\" in by hand; every");
    Serial.println("throughput figure is derived from it.");
  }

  for (const Model& m : kModels) runOne(m);

  Serial.println();
  Serial.print("done. "); Serial.print((int)(sizeof(kModels) / sizeof(kModels[0])));
  Serial.println(" models.");
}

void loop() {}
